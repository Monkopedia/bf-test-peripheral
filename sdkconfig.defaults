## sdkconfig.defaults
```kconfig
# Enable BLE with NimBLE stack
CONFIG_BT_ENABLED=y
CONFIG_BT_NIMBLE_ENABLED=y
CONFIG_BT_BLUEDROID_ENABLED=n

# BLE-only mode (ESP32-C6 doesn't support classic BT anyway)
CONFIG_BT_CONTROLLER_ENABLED=y

# NimBLE tuning
CONFIG_BT_NIMBLE_MAX_CONNECTIONS=1
CONFIG_BT_NIMBLE_ROLE_CENTRAL=n
CONFIG_BT_NIMBLE_ROLE_OBSERVER=n
CONFIG_BT_NIMBLE_ROLE_PERIPHERAL=y
CONFIG_BT_NIMBLE_ROLE_BROADCASTER=y

# Security manager for bonding tests
CONFIG_BT_NIMBLE_SM_LEGACY=y
CONFIG_BT_NIMBLE_SM_SC=y
CONFIG_BT_NIMBLE_NVS_PERSIST=y

# Stack sizes
CONFIG_FREERTOS_TIMER_TASK_STACK_DEPTH=4000

# Console output via USB-JTAG
CONFIG_ESP_CONSOLE_USB_SERIAL_JTAG=y
```
